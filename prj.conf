## CMakeLists.txt
```
# SPDX-License-Identifier: Apache-2.0

if (NOT DEFINED NO_EXAMPLES)
    cmake_minimum_required(VERSION 3.13.1)

    # This HAS to be above find package command!!!
    # This is only used in case of NRF9160
    # set(spm_DTC_OVERLAY_FILE 
    #     ${CMAKE_CURRENT_SOURCE_DIR}/boards/nrf9160dk_nrf9160spm.overlay)
    # set(spm_CONF_FILE prj.conf 
    #     ${CMAKE_CURRENT_LIST_DIR}/boards/nrf9160dk_nrf9160spm.conf)
    find_package(Zephyr HINTS $ENV{ZEPHYR_BASE})

    project(LR1110_transceiver_lib)
    zephyr_compile_options(-fdiagnostics-color=always)
    set(CMAKE_BUILD_TYPE Debug)

    # Change line below if you want to change example folder that will be used
    set(EXAMPLE_APPLICATION "wifi_scan")
    # Change line below to the board that you will be using
    add_definitions(-DDEVICE_BOARD="NRF52840")

    set(LR1110_EXAMPLE ${EXAMPLE_APPLICATION})
endif()

zephyr_include_directories(.)
zephyr_include_directories(src)
zephyr_include_directories(src/lr1110_driver)

set(CMAKE_EXPORT_COMPILE_COMMANDS ON)

FILE(GLOB example_dir examples/${LR1110_EXAMPLE}/*.c)
FILE(GLOB app_sources src/*.c)
FILE(GLOB lr1110_driver_sources src/lr1110_driver/*.c)

target_sources(app PRIVATE ${example_dir})
target_sources(app PRIVATE ${app_sources})
target_sources(app PRIVATE ${lr1110_driver_sources})
```

## prj.conf
```kconfig
CONFIG_GPIO=y
CONFIG_SPI=y

CONFIG_MAIN_STACK_SIZE=4096
```

## boards/nrf9160dk_nrf9160spm.conf
```kconfig
#CONFIG_IS_SPM=y
#CONFIG_FW_INFO=y
#CONFIG_GPIO=n
#
## Serial enable/disable
#CONFIG_UART_CONSOLE=n
#CONFIG_SERIAL=n
#
## Make watchdog timers non-secure (so they can be used in the non-secure image).
#CONFIG_SPM_NRF_WDT_NS=y
```

## boards/nrf52840dk_nrf52840.overlay
```dts
/*
 * Copyright (c) 2020, Irnas
 *
 */

/*
&spi2 {
    status = "okay";
	sck-pin= <15>;
	mosi-pin = <13>;
	miso-pin= <14>;
};
*/
&spi1 {
    status = "disabled";
};
```

## boards/nrf9160dk_nrf9160ns.overlay
```dts
/*
 * Copyright (c) 2020, Irnas
 *
 */

&uart1 {
	status = "disabled";
};
&spi3 {
    //sck-pin = <13>;
    //miso-pin = <12>;
    //mosi-pin = <11>;
    sck-pin = <24>;
    miso-pin = <23>;
    mosi-pin = <22>;
};
```

## boards/nrf9160dk_nrf9160spm.overlay
```dts
/*
 * Copyright (c) 2020, Irnas
 *
 */

&uart1 {
	status = "disabled";
};
```

## src/lr1110.c
```c
/** @file lr1110.c
 * 
 * @brief       Main lr1110.c file that calls all other modules. 
 *              Only this file should be included into application.
 *      
 *
 * @par       
 * COPYRIGHT NOTICE: (c) 2021 Irnas.  All rights reserved.
 */ 

#include "lr1110.h"
#include "lr1110_configs.h"
#include "lr1110_trx_board.h"
#include "lr1110_driver/lr1110_hal.h"
#include "lr1110_driver/lr1110_system_types.h"
#include "lr1110_driver/lr1110_system.h"
#include "lr1110_driver/lr1110_bootloader.h"

/* -------------------------------------------------------------------------
 * PRIVATE VARIABLES
 * ------------------------------------------------------------------------- */

/* -------------------------------------------------------------------------
 * PRIVATE PROTOTYPES
 * ------------------------------------------------------------------------- */

/* -------------------------------------------------------------------------
 * PUBLIC IMPLEMENTATIONS
 * ------------------------------------------------------------------------- */

void lr1110_init(const void * context)
{
    lr1110_gpio_init(context);
    lr1110_spi_init(context);

    lr1110_hal_reset(context);

    /* Added to let the radio perform it startup sequence */
    k_sleep(K_MSEC(500));

    if (lr1110_system_set_reg_mode(context, LR1110_SYSTEM_REG_MODE_DCDC)) {
        printk("Setting DCDC mode failed\n");
    }

    if (lr1110_rf_switch_init(context)) {
        printk("RF switch init failed\n");
    }

    if (lr1110_system_set_tcxo_mode(context, 
                                    LR1110_SYSTEM_TCXO_CTRL_3_0V, 
                                    500)){
        printk("Setting tcxo failed\n");
    }

    lr1110_system_cfg_lfclk(context, LR1110_SYSTEM_LFCLK_XTAL, true);
    lr1110_system_clear_errors(context);
    lr1110_system_calibrate(context, 0x3F); /* Value from Semtech's examples */

    uint16_t errors;
    lr1110_system_get_errors(context, &errors);
    lr1110_system_clear_errors(context);
    lr1110_system_clear_irq_status(context, LR1110_SYSTEM_IRQ_ALL_MASK);
}


void lr1110_get_trx_version(const void * context, 
                            lr1110_system_version_t * lr1110_version)
{
    if (lr1110_system_get_version(context, lr1110_version)) {
        printk("Getting system version failed\n");
    }
}


void lr1110_display_trx_version(const void * context)
{
    lr1110_system_version_t lr1110_version;
    lr1110_get_trx_version(context, &lr1110_version);

    printk("**************************************************************\n");
    printk("*                           VERSION                          *\n");
    printk("**************************************************************\n");
    printk("HARDWARE : 0x%02X\n",    lr1110_version.hw);
    printk("TYPE     : 0x%02X\n",    lr1110_version.type);
    printk("FIRMWARE : 0x%04X\n\n",  lr1110_version.fw);
}

void lr1110_set_device_config(void * context, const char * device)
{
    lr1110_set_config(context, device);
}

void lr1110_prepare_event(void * context, lr1110_system_irq_mask_t event_mask)
{
    lr1110_system_set_dio_irq_params(context, event_mask, 0);
}

void lr1110_wait_for_event(void * context)
{
	while (0 == gpio_pin_get(((lr1110_t*) context)->event.port, 
                             ((lr1110_t*) context)->event.pin));
}

void lr1110_clear_event(void * context, lr1110_system_irq_mask_t event_mask)
{
    lr1110_system_clear_irq_status(context,  event_mask);
}

/* -------------------------------------------------------------------------
 * PRIVATE IMPLEMENTATIONS
 * ------------------------------------------------------------------------- */

/*** end of file ***/
```

## src/lr1110.h
```c
/** @file lr1110.h
 * 
 * @brief       Main lr1110.h file that calls all other modules. 
 *              Only this file should be included into application.
 *      
 *
 * @par       
 * COPYRIGHT NOTICE: (c) 2021 Irnas.  All rights reserved.
 */ 
 
#ifndef LR1110_TRX_H
#define LR1110_TRX_H

#ifdef __cplusplus
extern "C" {
#endif

#include <zephyr.h>
#include <device.h>
#include <drivers/gpio.h>
#include "lr1110_driver/lr1110_system.h"
#include "lr1110_driver/lr1110_system_types.h"
#include "lr1110_wifi_scan.h"


/*!
 * @brief Struct for storing data about port and pin number for each physical
 *        pin. If using GPIO_0, port should be set to 0, if using GPIO_1 then 
 *        set to 1.
 */
typedef struct
{
    struct device * port;
    gpio_pin_t pin;
} port_pin_t;

/*!
 * @brief Radio hardware and global parameters, also known as context
 */
typedef struct
{
    port_pin_t reset;
    port_pin_t nss;
    port_pin_t event;
    port_pin_t busy;
    port_pin_t lna;
    char * spi_dev_label;
    lr1110_system_rfswitch_cfg_t * rf_switch_cfg;
    void (*event_interrupt_cb)(void);
    gpio_flags_t event_trigger_type;
} lr1110_t;


void lr1110_init(const void * context);
void lr1110_set_device_config(void * context, const char * device);

void lr1110_get_trx_version(const void * context, 
                            lr1110_system_version_t * lr1110_version);
void lr1110_display_trx_version(const void * context);

void lr1110_prepare_event(void * context, lr1110_system_irq_mask_t event_mask);
void lr1110_wait_for_event(void * context);
void lr1110_clear_event(void * context, lr1110_system_irq_mask_t event_mask);

#ifdef __cplusplus
}
#endif

#endif /* LR1110_TRX_H */
/*** end of file ***/
```

## src/lr1110_configs.c
```c
/** @file lr1110_configs.c
 * 
 * @brief       Main lr1110.h file that calls all other modules. 
 *              Only this file should be included into application.
 *      
 *
 * @par       
 * COPYRIGHT NOTICE: (c) 2021 Irnas.  All rights reserved.
 */ 

#include <string.h>
#include "lr1110.h"
#include "lr1110_configs.h"

/* -------------------------------------------------------------------------
 * PRIVATE VARIABLES
 * ------------------------------------------------------------------------- */

/*!
 * @brief Port labels found in generated device tree source, this can be further
 *        added, however it should be also updated in create_port_pin funciton.  
 */
typedef enum 
{
    ZEPHYR_GPIO_0 = 0x00,    
    ZEPHYR_GPIO_1,
    ZEPHYR_GPIO_2,
    ZEPHYR_GPIO_3,
    ZEPHYR_GPIOA,
    ZEPHYR_GPIOB,
    ZEPHYR_GPIOC,
    ZEPHYR_GPIOD,
    ZEPHYR_GPIOE,
} port_label_t; 


/* -------------------------------------------------------------------------
 * PRIVATE PROTOTYPES
 * ------------------------------------------------------------------------- */
static void lr1110_set_nrf52832_config(void * context);
static void lr1110_set_nrf52840_config(void * context);
static void lr1110_set_nrf9160_config(void * context);
static port_pin_t create_port_pin(port_label_t port, gpio_pin_t pin);


/* -------------------------------------------------------------------------
 * PUBLIC IMPLEMENTATIONS
 * ------------------------------------------------------------------------- */

/*!
 * @brief               Sets device config 
 *
 * @param[in] device    Device name in string representation 
 *
 * @note                List of possible devices has to be mainted 
 *                      in README file.
 */
void lr1110_set_config(void * context, const char * device)
{
    if (strcmp(device, "NRF52832") == 0)
    {
        lr1110_set_nrf52832_config(context);
    }
    else if (strcmp(device, "NRF52840") == 0) 
    {
        lr1110_set_nrf52840_config(context);
    }
    else if (strcmp(device, "NRF9160") == 0) 
    {
        lr1110_set_nrf9160_config(context);
    }
    else
    {
        printk("ERROR: INCORRECT DEVICE CONFIG\n");
        while(1);
    }
}

/* -------------------------------------------------------------------------
 * PRIVATE IMPLEMENTATIONS
 * ------------------------------------------------------------------------- */


/*!
 * @brief               Creates a defult pin config for LR1110 evk
 *                      shield and nrf52832 combo 
 *
 * @param[in] context   Radio abstraction
 */
static void lr1110_set_nrf52832_config(void * context)
{
    ((lr1110_t*) context)->reset = create_port_pin(ZEPHYR_GPIO_0, 3);
    ((lr1110_t*) context)->nss   = create_port_pin(ZEPHYR_GPIO_0, 18);
    ((lr1110_t*) context)->event = create_port_pin(ZEPHYR_GPIO_0, 17);
    ((lr1110_t*) context)->busy  = create_port_pin(ZEPHYR_GPIO_0, 14);
    ((lr1110_t*) context)->lna   = create_port_pin(ZEPHYR_GPIO_0, 29);
    ((lr1110_t*) context)->spi_dev_label = "SPI_2";

    /* Default, EVK shield configuration is used */ 
    ((lr1110_t*) context)->rf_switch_cfg = NULL;
    ((lr1110_t*) context)->event_interrupt_cb = NULL;
    ((lr1110_t*) context)->event_trigger_type = GPIO_INT_LEVEL_HIGH;
}


/*!
 * @brief               Creates a defult pin config for LR1110 evk
 *                      shield and nrf52840 combo 
 *
 * @param[in] context   Radio abstraction
 */
static void lr1110_set_nrf52840_config(void * context)
{
    ((lr1110_t*) context)->reset = create_port_pin(ZEPHYR_GPIO_0, 3);
    ((lr1110_t*) context)->nss   = create_port_pin(ZEPHYR_GPIO_1, 8);
    ((lr1110_t*) context)->event = create_port_pin(ZEPHYR_GPIO_1, 6);
    ((lr1110_t*) context)->busy  = create_port_pin(ZEPHYR_GPIO_1, 4);
    ((lr1110_t*) context)->lna   = create_port_pin(ZEPHYR_GPIO_0, 29);
    ((lr1110_t*) context)->spi_dev_label = "SPI_3";

    /* Default, EVK shield configuration is used */ 
    ((lr1110_t*) context)->rf_switch_cfg = NULL;
    ((lr1110_t*) context)->event_interrupt_cb = NULL;
    ((lr1110_t*) context)->event_trigger_type = GPIO_INT_LEVEL_HIGH;
}


/*!
 * @brief               Creates a defult pin config for LR1110 evk
 *                      shield and NRF9160DK combo, shield is not directly
 *                      connected to DK, but with wires as some pins could not
 *                      be used. On board NRF52840 has to be properly 
 *                      configurated as well.
 *
 * @param[in] context   Radio abstraction
 */
static void lr1110_set_nrf9160_config(void * context)
{
    ((lr1110_t*) context)->reset = create_port_pin(ZEPHYR_GPIO_0, 14);
    ((lr1110_t*) context)->nss   = create_port_pin(ZEPHYR_GPIO_0, 7);
    ((lr1110_t*) context)->event = create_port_pin(ZEPHYR_GPIO_0, 5);
    ((lr1110_t*) context)->busy  = create_port_pin(ZEPHYR_GPIO_0, 3);
    ((lr1110_t*) context)->lna   = create_port_pin(ZEPHYR_GPIO_0, 17);
    ((lr1110_t*) context)->spi_dev_label = "SPI_3";

    /* Default, EVK shield configuration is used */ 
    ((lr1110_t*) context)->rf_switch_cfg = NULL;
    ((lr1110_t*) context)->event_interrupt_cb = NULL;
    ((lr1110_t*) context)->event_trigger_type = GPIO_INT_LEVEL_HIGH;
}


/*!
 * @brief                   Helper function that creates port_pin struct
 *
 * @param[in] Port          Ports are written exactly the same as they appear in 
 *                          device tree, prepended with ZEPHYR_.
 *                          This is done to avoid clashes with some other 
 *                          libraries.
 * @param[in] Pin           
 * @return port_pin struct
 */
static port_pin_t create_port_pin(port_label_t port, gpio_pin_t pin)
{
    const char * port_label;

    switch (port)
    {
        case ZEPHYR_GPIO_0: port_label = "GPIO_0"; break; 
        case ZEPHYR_GPIO_1: port_label = "GPIO_1"; break; 
        case ZEPHYR_GPIO_2: port_label = "GPIO_2"; break; 
        case ZEPHYR_GPIO_3: port_label = "GPIO_3"; break; 
        case ZEPHYR_GPIOA:  port_label = "GPIOA";  break; 
        case ZEPHYR_GPIOB:  port_label = "GPIOB";  break; 
        case ZEPHYR_GPIOC:  port_label = "GPIOC";  break; 
        case ZEPHYR_GPIOD:  port_label = "GPIOD";  break; 
        case ZEPHYR_GPIOE:  port_label = "GPIOE";  break; 

        default:
            printk("This GPIO port is not supported!\n");
            while(1);
        break; 
    }
    struct device * port_device = (struct device *) device_get_binding(port_label);

    port_pin_t created_port_pin = {
        .port = port_device, 
        .pin = pin
    };
    return created_port_pin;
}
/*** end of file ***/
```

## src/lr1110_configs.h
```c
/** @file lr1110_configs.c
 * 
 * @brief       Main lr1110.h file that calls all other modules. 
 *              Only this file should be included into application.
 *      
 *
 * @par       
 * COPYRIGHT NOTICE: (c) 2021 Irnas.  All rights reserved.
 */ 
 
#ifndef LR1110_CONFIGS_H
#define LR1110_CONFIGS_H

#ifdef __cplusplus
extern "C" {
#endif

void lr1110_set_config(void * context, const char * device);

#ifdef __cplusplus
}
#endif

#endif  // LR1110_CONFIGS_H

/*** end of file ***/
```

## src/lr1110_trx_board.c
```c
/** @file lr1110_trx_board.c
 * 
 * @brief This module deals with GPIO and SPI initializations in connection
 *        with lr1110 chip. It implements functions declared in lr1110_hal.h, 
 *        as well in lr1110-modem-board.h
 *
 * @par       
 * COPYRIGHT NOTICE: (c) 2021 Irnas. All rights reserved.
 */ 

#include <zephyr.h>
#include <device.h>
#include <drivers/gpio.h>
#include <drivers/spi.h>

#include "lr1110_trx_board.h"
#include "lr1110.h"
#include "lr1110_driver/lr1110_hal.h"
#include "lr1110_driver/lr1110_system.h"
#include "lr1110_driver/lr1110_system_types.h"


/* -------------------------------------------------------------------------
 * PRIVATE VARIABLES
 * ------------------------------------------------------------------------- */
static const struct device * spi_dev;
static struct spi_config spi_cfg;


/* -------------------------------------------------------------------------
 * PRIVATE PROTOTYPES
 * ------------------------------------------------------------------------- */
static void lr1110_set_nss(const void * context, uint8_t level);
static lr1110_hal_status_t lr1110_hal_wait_busy(const void * context, 
                                                uint32_t timeout_ms);
static void lr1110_spi_write(const void * context,
                             const uint8_t * command, 
                             const uint16_t command_length);
static void lr1110_spi_read(const void * context,
                            uint8_t * data, 
                            uint16_t data_length);


//static void lr1110_spi_read(const void * context,
//                            uint8_t *command, 
//                            uint8_t size_command,
//                            uint8_t * data, 
//                            uint16_t data_length);


static void lr1110_spi_write_read(const void * context, 
                                  const uint8_t * command, 
                                  uint8_t * data,
                                  const uint16_t data_length);
static lr1110_system_rfswitch_cfg_t create_evk_shield_rf_switch();

lr1110_hal_status_t lr1110_hal_wakeup(const void * context);
/* -------------------------------------------------------------------------
 * PUBLIC IMPLEMENTATIONS
 * ------------------------------------------------------------------------- */

/*!
 * @brief               Initializes GPIO peripherals for LR1110 
 *
 * @param[in] context   Radio abstraction
 */
void lr1110_gpio_init(const void * context)
{
    /*  Nss pin, output, it is needed here because of lr1110_hal_wakeup */
    gpio_pin_configure(((lr1110_t*) context)->nss.port, 
                       ((lr1110_t*) context)->nss.pin,
                       GPIO_OUTPUT_HIGH);
    /* Reset pin, output */
	gpio_pin_configure(((lr1110_t*) context)->reset.port, 
                       ((lr1110_t*) context)->reset.pin,
                       GPIO_OUTPUT_HIGH);
    /* Busy pin, input */
	gpio_pin_configure(((lr1110_t*) context)->busy.port, 
                       ((lr1110_t*) context)->busy.pin,
                       GPIO_INPUT);
    /* LNA pin, output */
	gpio_pin_configure(((lr1110_t*) context)->lna.port, 
                       ((lr1110_t*) context)->lna.pin,
                       GPIO_OUTPUT_LOW);

	gpio_pin_configure(((lr1110_t*) context)->event.port, 
                       ((lr1110_t*) context)->event.pin,
                       GPIO_INPUT);
}


/*!
 * @brief               Initializes SPI peripheral for LR1110 
 *
 * @param[in] context   Radio abstraction
 * @note                Nss pin has to be controlled manually, as automatic 
 *                      control thourgh spi_cs_ctrl does not work
 */
void lr1110_spi_init(const void * context)
{
    spi_dev = device_get_binding(((lr1110_t*) context)->spi_dev_label);

    if (!spi_dev){
        printk("spi device not found: %s\n", 
                ((lr1110_t*) context)->spi_dev_label);
    }

    spi_cfg.operation = (SPI_OP_MODE_MASTER | 
                         SPI_TRANSFER_MSB | 
                         SPI_WORD_SET(8));

    spi_cfg.frequency = 4000000;
    spi_cfg.slave = 0;
}


/*!
 * @brief                       HAL write
 *
 * @param[in] context           Radio abstraction
 * @param[in] command           Pointer to the buffer to be transmitted
 * @param[in] command_length    Buffer size to be transmitted
 * @param[out] data             Pointer to the buffer to be transmitted
 * @param[in] data_length       Buffer size to be transmitted
 *
 * @return status               HAL status
 */
lr1110_hal_status_t lr1110_hal_write(const void * context, 
                                     const uint8_t * command, 
                                     const uint16_t command_length, 
                                     const uint8_t * data, 
                                     const uint16_t data_length)
{
    if(lr1110_hal_wait_busy(context, 2000)) {
        return LR1110_HAL_STATUS_ERROR;
    }

    lr1110_set_nss(context, 0);
    lr1110_spi_write(context, command, command_length);
    lr1110_spi_write(context, data, data_length);
    lr1110_set_nss(context, 1);

    return LR1110_HAL_STATUS_OK;
}


/*!
 * @brief                       HAL read
 *
 * @param[in] context           Radio abstraction
 * @param[in] command           Pointer to the buffer to be transmitted
 * @param[in] command_length    Buffer size to be transmitted
 * @param[out] data             Pointer to the buffer to be received
 * @param[in] data_length       Buffer size to be received
 *
 * @return status               HAL status
 */
lr1110_hal_status_t lr1110_hal_read(const void * context, 
                                    const uint8_t * command, 
                                    const uint16_t command_length, 
                                    uint8_t * data, 
                                    const uint16_t data_length)
{
    uint8_t dummy = 0x00;

    if(lr1110_hal_wait_busy(context, 2000)) {
        return LR1110_HAL_STATUS_ERROR;
    }

    /* 1st SPI transaction */
    lr1110_set_nss(context, 0);
    lr1110_spi_write(context, command, command_length);
    lr1110_set_nss(context, 1);

    if(lr1110_hal_wait_busy(context, 2000)) {
        return LR1110_HAL_STATUS_ERROR;
    }

    /* 2nd SPI transaction */
    lr1110_set_nss(context, 0);
    lr1110_spi_write(context, &dummy, 1);
    lr1110_spi_read(context, data, data_length);
    lr1110_set_nss(context, 1);

    return LR1110_HAL_STATUS_OK;
}


/*!
 * @brief                       HAL write read
 *
 * @param[in] context           Radio abstraction
 * @param[in] command           Pointer to the buffer to be transmitted
 * @param[out] data             Pointer to the buffer to be received
 * @param[in] data_length       Size of both buffers
 *
 * @return status               HAL status
 */
lr1110_hal_status_t lr1110_hal_write_read(const void * context, 
                                          const uint8_t * command, 
                                          uint8_t * data, 
                                          const uint16_t data_length)
{
    if(lr1110_hal_wait_busy(context, 2000)) {
        return LR1110_HAL_STATUS_ERROR;
    }

    lr1110_set_nss(context, 0);
    lr1110_spi_write_read(context, command, data, data_length);
    lr1110_set_nss(context, 1);

    return LR1110_HAL_STATUS_OK;
}


/*!
 * @brief               Configures RF switches
 *
 * @param[in] context   Radio abstraction
 */
lr1110_status_t lr1110_rf_switch_init(const void * context)
{
    lr1110_system_rfswitch_cfg_t rf_switch_cfg;

    if (((lr1110_t*) context)->rf_switch_cfg != NULL) {
        /* Custom rf switch configuration is used */
        rf_switch_cfg = *(((lr1110_t*) context)->rf_switch_cfg);
    }
    else {
        /* Default, EVK shield configuration is used */
        rf_switch_cfg = create_evk_shield_rf_switch();
    }
    
    return lr1110_system_set_dio_as_rf_switch(context, &rf_switch_cfg);
}


/*!
 * @brief               Function returns rf switch configuration for 
 *                      LR1110 EVK shield
 *
 * @return rf_switch_configuration struct
 */
static lr1110_system_rfswitch_cfg_t create_evk_shield_rf_switch()
{
    lr1110_system_rfswitch_cfg_t rf_switch_configuration;

    rf_switch_configuration.enable  = LR1110_SYSTEM_RFSW0_HIGH | 
                                      LR1110_SYSTEM_RFSW1_HIGH | 
                                      LR1110_SYSTEM_RFSW2_HIGH;
    rf_switch_configuration.standby = 0;

    /* LoRa SPDT */
    rf_switch_configuration.rx = LR1110_SYSTEM_RFSW0_HIGH;
    rf_switch_configuration.tx = LR1110_SYSTEM_RFSW0_HIGH | 
                                 LR1110_SYSTEM_RFSW1_HIGH;

    rf_switch_configuration.tx_hp = LR1110_SYSTEM_RFSW1_HIGH;

	/* GNSS LNA ON */
    rf_switch_configuration.gnss = LR1110_SYSTEM_RFSW2_HIGH;

    rf_switch_configuration.tx_hf = 0x00;
    rf_switch_configuration.wifi = 0x00;

    return rf_switch_configuration;
}


/* -------------------------------------------------------------------------
 * PRIVATE IMPLEMENTATIONS
 * ------------------------------------------------------------------------- */


/*!
 * @brief                       Set slave select line
 *
 * @param[in] context           Radio abstraction
 * @param[in] level             Logical level of slave select line
 */
static void lr1110_set_nss(const void * context, uint8_t level)
{
	gpio_pin_set(((lr1110_t*) context)->nss.port, 
                 ((lr1110_t*) context)->nss.pin, level);
}


/*!
 * @brief                       Perform reset of LR1110 chip
 *
 * @param[in] context           Radio abstraction
 */
lr1110_hal_status_t lr1110_hal_reset(const void * context)
{
	gpio_pin_set(((lr1110_t*) context)->reset.port, 
                 ((lr1110_t*) context)->reset.pin, 0);
    k_sleep(K_MSEC(500));
	gpio_pin_set(((lr1110_t*) context)->reset.port, 
                 ((lr1110_t*) context)->reset.pin, 1);

    return LR1110_HAL_STATUS_OK;
}


/*!
 * @brief                       Perform wakeup sequence of LR1110 chip
 *
 * @param[in] context           Radio abstraction
 *
 * @return status               HAL status
 */
lr1110_hal_status_t lr1110_hal_wakeup(const void * context)
{
    lr1110_set_nss(context, 0);
    k_sleep(K_MSEC(1));
    lr1110_set_nss(context, 1);

    return LR1110_HAL_STATUS_OK;
}

/*!
 * @brief                       Perform wakeup sequence of LR1110 chip
 *
 * @param[in] context           Radio abstraction
 * @param[in] timeout_ms        Timeout in milliseconds
 *
 * @return status               HAL status
 */
static lr1110_hal_status_t lr1110_hal_wait_busy(const void * context, 
                                                uint32_t timeout_ms)
{
    uint32_t start = k_uptime_get();

    /* Wait while busy is HIGH */
	while (1 == gpio_pin_get(((lr1110_t*) context)->busy.port, 
                             ((lr1110_t*) context)->busy.pin))
    {
        if ((k_uptime_get() - start) > timeout_ms)
        {
            printk("------------------------------------------------------\n");
            printk("WAIT BUSY TIMEOUTED\n");
            printk("THIS SHOULD NOT HAPPEN\n");
            printk("------------------------------------------------------\n");
            return LR1110_HAL_STATUS_ERROR;
        }
    }
    return LR1110_HAL_STATUS_OK;
}


/*!
 * @brief                       Wrapper for SPI write communication
 *
 * @param[in] context           Radio abstraction
 * @param[in] command           Pointer to command bytes
 * @param[in] command_length
 *
 * @note                        NSS line is toggled manually.
 */
static void lr1110_spi_write(const void * context,
                             const uint8_t * command,
                             uint16_t command_length)
{
    struct spi_buf tx_buf = {
        .buf = (uint8_t*) command,
        .len = command_length
    };

    const struct spi_buf_set tx = {
        .buffers = &tx_buf,
        .count = 1
    };

    spi_write(spi_dev, &spi_cfg, &tx);
}


/*!
 * @brief                       Wrapper for SPI read communication
 *
 * @param[in] context           Radio abstraction
 * @param[out] data             Pointer to data array, that comes from LR1110
 * @param[in] data_length       
 *
 * @note                        NSS line is toggled manually.
 */
static void lr1110_spi_read(const void * context,
                            //uint8_t *command, 
                            //uint8_t size_command,
                            uint8_t * data, 
                            uint16_t data_length)
{
    struct spi_buf rx_buf = {
        .buf = data,
        .len = data_length
    };

    const struct spi_buf_set rx = {
        .buffers = &rx_buf,
        .count = 1
    };

    spi_read(spi_dev, &spi_cfg, &rx);
}

/*!
 * @brief                       Wrapper for SPI read communication
 *
 * @param[in] context           Radio abstraction
 * @param[in] command           
 * @param[out] data             Pointer to data array, that comes from LR1110
 * @param[in] data_length       Length of command and data
 *
 * @note                        NSS line is toggled manually.
 */
static void lr1110_spi_write_read(const void * context, 
                                  const uint8_t * command, 
                                  uint8_t * data,
                                  const uint16_t data_length)
{
    const struct spi_buf tx_buf = {
        .buf = (uint8_t*) command,
        .len = data_length
    };
    struct spi_buf rx_buf = {
        .buf = data,
        .len = data_length
    };

    const struct spi_buf_set tx = {
      .buffers = &tx_buf,
      .count = 1
    };
    struct spi_buf_set rx = {
      .buffers = &rx_buf,
      .count = 1
    };

    spi_transceive(spi_dev, &spi_cfg, &tx, &rx);
}

/*** end of file ***/
```

## src/lr1110_trx_board.h
```c
/** @file lr1110_trx_board.h
 * 
 * @brief This module deals with GPIO and SPI initializations in connection
 *        with lr1110 chip. It implements functions declared in lr1110_hal.h, 
 *        as well in lr1110-modem-board.h
 *
 * @par       
 * COPYRIGHT NOTICE: (c) 2020 Irnas.  All rights reserved.
 */ 
 
#ifndef LR1110_TRX_BOARD_H
#define LR1110_TRX_BOARD_H

#ifdef __cplusplus
extern "C" {
#endif

#include "lr1110_types.h"

void lr1110_gpio_init(const void * context);
void lr1110_spi_init(const void * context);
lr1110_status_t lr1110_rf_switch_init(const void * context);

#ifdef __cplusplus
}
#endif

#endif  // LR1110_TRX_BOARD_H

/*** end of file ***/
```

## src/lr1110_wifi_scan.c
```c
/** @file lr1110_wifi_scan.c
 *
 * @brief       Module containing various function wrappers for wifi scanning.
 *
 *
 * @par
 * COPYRIGHT NOTICE: (c) 2021 Irnas.  All rights reserved.
 */

#include "lr1110_wifi_scan.h"
#include "lr1110.h"

/* -------------------------------------------------------------------------
 * PRIVATE VARIABLES
 * ------------------------------------------------------------------------- */

/* -------------------------------------------------------------------------
 * PRIVATE PROTOTYPES
 * ------------------------------------------------------------------------- */

/* -------------------------------------------------------------------------
 * PUBLIC IMPLEMENTATIONS
 * ------------------------------------------------------------------------- */
void lr1110_init_wifi_scan(void * context)
{
    lr1110_wifi_reset_cumulative_timing(context);
    lr1110_wifi_cfg_hardware_debarker(context, true);
}

#define DEMO_WIFI_CHANNELS_DEFAULT                                       \
    ( ( 1 << LR1110_WIFI_CHANNEL_11 ) + ( 1 << LR1110_WIFI_CHANNEL_6 ) + \
      ( 1 << LR1110_WIFI_CHANNEL_1 ) )

struct wifi_settings lr1110_get_default_wifi_settings()
{
    struct wifi_settings wifi_settings = {
        .signal_type            = LR1110_WIFI_TYPE_SCAN_B_G_N,
        .channels               = LR1110_WIFI_ALL_CHANNELS,
        .scan_mode              = LR1110_WIFI_SCAN_MODE_FULL_BEACON,
        .max_results            = LR1110_WIFI_MAX_RESULTS,
        .nb_scan_per_channel    = 30,
        .timeout_in_ms          = 110,
        .abort_on_timeout       = false,
    };
    return wifi_settings;
}


struct wifi_diagnostics
lr1110_execute_wifi_scan(void * context, struct wifi_settings wifi_settings)
{
    struct wifi_diagnostics wifi_diagnostics = {0};

    /* Prepare event intterupt line */
    lr1110_prepare_event(context, LR1110_SYSTEM_IRQ_WIFI_SCAN_DONE);

    uint32_t start_scan = k_uptime_get();

    /* Start up wifi scan, function itself is not blocking,
     * however, we wait for WIFI_SCAN_DONE event,
     * as it currently does not make sense to implement interrupt. */
    lr1110_wifi_scan(context,
                     wifi_settings.signal_type,
                     wifi_settings.channels,
                     wifi_settings.scan_mode,
                     wifi_settings.max_results,
                     wifi_settings.nb_scan_per_channel,
                     wifi_settings.timeout_in_ms,
                     wifi_settings.abort_on_timeout);

    /* Blocking wait */
    lr1110_wait_for_event(context);
    uint32_t end_scan = k_uptime_get();

    wifi_diagnostics.wifi_scan_duration = end_scan - start_scan;

    /* Clear event interrupt line */
    lr1110_clear_event(context, LR1110_SYSTEM_IRQ_WIFI_SCAN_DONE);

    /* Get number of wifi scan results */
    start_scan = k_uptime_get();
    lr1110_wifi_get_nb_results(context, &wifi_diagnostics.num_wifi_results);
    printk("Number of resutls: %d\n", wifi_diagnostics.num_wifi_results);
    end_scan = k_uptime_get();

    wifi_diagnostics.result_fetch_duration = end_scan - start_scan;
    return wifi_diagnostics;
}


void
lr1110_get_wifi_scan_results(void * context,
                             struct wifi_diagnostics wifi_diagnostics,
                             lr1110_wifi_basic_complete_result_t * results)
{
    lr1110_wifi_read_basic_complete_results(context,
                                            0,  /* start result index */
                                            wifi_diagnostics.num_wifi_results,
                                            results);
}


void
lr1110_get_ext_wifi_scan_results(void * context,
                                 struct wifi_diagnostics wifi_diagnostics,
                                 lr1110_wifi_extended_full_result_t * results)
{
    printk("start1\n");
    lr1110_wifi_read_extended_full_results(context,
                                           0,
                                           wifi_diagnostics.num_wifi_results,
                                           results);
    printk("start2\n");
}


void
lr1110_print_wifi_scan_results(void * contex,
                               struct wifi_diagnostics wifi_diagnostics,
                               lr1110_wifi_basic_complete_result_t * results)
{

    printk("**************************************************************\n");
    printk("*                      WIFI SCAN RESULTS                     *\n");
    printk("**************************************************************\n");
    printk("Scan duration:          %d ms\n",
            wifi_diagnostics.wifi_scan_duration);
    printk("Fetch result duration:  %d ms\n",
            wifi_diagnostics.result_fetch_duration);
    printk("Number of wifi results: %d\n",
            wifi_diagnostics.num_wifi_results);

    /* Print results*/
    for (int i = 0; i < wifi_diagnostics.num_wifi_results; i++)
    {
        printk("{\n\t\"macAddress\": \"");
        for (int j = 0; j < LR1110_WIFI_MAC_ADDRESS_LENGTH; j++)
        {
            printk(" %02x:", results[i].mac_address[j]);
        }
        printk("\",\n\t\"signalStrength\": ");
        printk("%d\n},\n", results[i].rssi);
    }
}

void
lr1110_print_ext_wifi_scan_results(void * contex,
                                   struct wifi_diagnostics wifi_diagnostics,
                                   lr1110_wifi_extended_full_result_t * results)
{

    printk("**************************************************************\n");
    printk("*                 EXTENDED WIFI SCAN RESULTS                 *\n");
    printk("**************************************************************\n");
    printk("Scan duration:          %d ms\n",
            wifi_diagnostics.wifi_scan_duration);
    printk("Fetch result duration:  %d ms\n",
            wifi_diagnostics.result_fetch_duration);
    printk("Number of wifi results: %d\n",
            wifi_diagnostics.num_wifi_results);

    /* Print results*/
    for (int i = 0; i < wifi_diagnostics.num_wifi_results; i++)
    {
        printk("{\n\t\"macAddress\": \"");
        for (int j = 0; j < LR1110_WIFI_MAC_ADDRESS_LENGTH; j++)
        {
            printk(" %02x:", results[i].mac_address_1[j]);
        }
        printk("\",\n\t\"signalStrength\": ");
        printk("%d\n},\n", results[i].rssi);
    }
    for (int i = 0; i < wifi_diagnostics.num_wifi_results; i++)
    {
        printk("{\n\t\"macAddress\": \"");
        for (int j = 0; j < LR1110_WIFI_MAC_ADDRESS_LENGTH; j++)
        {
            printk(" %02x:", results[i].mac_address_2[j]);
        }
        printk("\",\n\t\"signalStrength\": ");
        printk("%d\n},\n", results[i].rssi);
    }
    for (int i = 0; i < wifi_diagnostics.num_wifi_results; i++)
    {
        printk("{\n\t\"macAddress\": \"");
        for (int j = 0; j < LR1110_WIFI_MAC_ADDRESS_LENGTH; j++)
        {
            printk(" %02x:", results[i].mac_address_3[j]);
        }
        printk("\",\n\t\"signalStrength\": ");
        printk("%d\n},\n", results[i].rssi);
    }
}
/* -------------------------------------------------------------------------
 * PRIVATE IMPLEMENTATIONS
 * ------------------------------------------------------------------------- */

/*** end of file ***/
```

## src/lr1110_wifi_scan.h
```c
/** @file lr1110_wifi_scan.h
 *
 * @brief       Module containing various function wrappers for wifi scanning.
 *
 *
 * @par
 * COPYRIGHT NOTICE: (c) 2021 Irnas.  All rights reserved.
 */

#ifndef LR1110_WIFI_SCAN_H
#define LR1110_WIFI_SCAN_H

#ifdef __cplusplus
extern "C" {
#endif

#include <zephyr.h>
#include "lr1110_driver/lr1110_wifi.h"
#include "lr1110_driver/lr1110_wifi_types.h"


struct wifi_settings
{
    lr1110_wifi_signal_type_scan_t signal_type;
    lr1110_wifi_channel_mask_t channels;
    lr1110_wifi_mode_t scan_mode;
    uint8_t max_results;
    uint8_t nb_scan_per_channel;
    uint16_t timeout_in_ms;
    bool abort_on_timeout;
};

struct wifi_diagnostics {
    uint32_t wifi_scan_duration;
    uint32_t result_fetch_duration;
    uint8_t num_wifi_results;
};

void lr1110_init_wifi_scan(void * context);
struct wifi_diagnostics
lr1110_execute_wifi_scan(void * context, struct wifi_settings wifi_settings);
struct wifi_settings lr1110_get_default_wifi_settings();
void
lr1110_get_wifi_scan_results(void * context,
                             struct wifi_diagnostics wifi_diagnostics,
                             lr1110_wifi_basic_complete_result_t * results);
void
lr1110_print_wifi_scan_results(void * contex,
                               struct wifi_diagnostics wifi_diagnostics,
                               lr1110_wifi_basic_complete_result_t * results);

void
lr1110_get_ext_wifi_scan_results(void * context,
                                 struct wifi_diagnostics wifi_diagnostics,
                                 lr1110_wifi_extended_full_result_t * results);
void
lr1110_print_ext_wifi_scan_results(void * contex,
                                   struct wifi_diagnostics wifi_diagnostics,
                                   lr1110_wifi_extended_full_result_t * results);
#ifdef __cplusplus
}
#endif

#endif /* LR1110_WIFI_SCAN_H */
/*** end of file ***/
```
